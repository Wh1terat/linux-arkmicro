## buildroot-external/configs/ark1668e_c281_defconfig
```kconfig
BR2_arm=y
BR2_cortex_a7=y
BR2_ARM_FPU_NEON=y
BR2_TOOLCHAIN_EXTERNAL=y
BR2_TOOLCHAIN_EXTERNAL_LINARO_ARM=y
BR2_ROOTFS_DEVICE_CREATION_DYNAMIC_EUDEV=y
BR2_TARGET_GENERIC_ROOT_PASSWD="root"
# BR2_TARGET_GENERIC_REMOUNT_ROOTFS_RW is not set
BR2_ROOTFS_OVERLAY="$(BR2_EXTERNAL_ARK_PATH)/board/arkmicro/ark1668e_c281/rootfs_overlay"
BR2_ROOTFS_POST_BUILD_SCRIPT="$(BR2_EXTERNAL_ARK_PATH)/board/arkmicro/ark1668e_c281/post_build.sh"
BR2_PACKAGE_BUSYBOX_CONFIG="$(BR2_EXTERNAL_ARK_PATH)/board/arkmicro/ark1668e_c281/busybox.config"
BR2_PACKAGE_ALSA_UTILS=y
BR2_PACKAGE_ALSA_UTILS_AMIXER=y
BR2_PACKAGE_ALSA_UTILS_APLAY=y
BR2_PACKAGE_GDB=y
BR2_PACKAGE_LMBENCH=y
BR2_PACKAGE_STRESS_NG=y
BR2_PACKAGE_TINYMEMBENCH=y
BR2_PACKAGE_EUDEV_RULES_GEN=y
BR2_PACKAGE_LIBMAD=y
BR2_PACKAGE_LIBVORBIS=y
BR2_PACKAGE_LZO=y
BR2_PACKAGE_LIBUSB=y
BR2_PACKAGE_LIBUSB_COMPAT=y
BR2_PACKAGE_LIBXML2=y
BR2_PACKAGE_MXML=y
BR2_PACKAGE_LIBFFI=y
BR2_PACKAGE_PROTOBUF=y
# BR2_PACKAGE_IFUPDOWN_SCRIPTS is not set
BR2_PACKAGE_IPERF=y
BR2_PACKAGE_IPERF3=y
BR2_PACKAGE_IPROUTE2=y
BR2_PACKAGE_OPENSSH=y
BR2_PACKAGE_TCPDUMP=y
BR2_PACKAGE_ANDROID_TOOLS=y
BR2_PACKAGE_UTIL_LINUX_LIBUUID=y
BR2_TARGET_ROOTFS_EXT2=y
BR2_TARGET_ROOTFS_EXT2_4=y
BR2_TARGET_ROOTFS_EXT2_SIZE="400M"
# BR2_TARGET_ROOTFS_TAR is not set
BR2_PACKAGE_LIBARKAPI=y
BR2_LIBARKAPI_ARK1668E=y
BR2_PACKAGE_LIBDNS_SD=y
BR2_PACKAGE_LIBMALI=y
```

## buildroot-external/package/usb_eye_diagram_tool/Config.in
```kconfig
config BR2_PACKAGE_USB_EYE_DIAGRAM_TOOL
	bool "usb_eye_diagram_tool"
	help
		USB Eye Diagram Tool
```

## u-boot/board/arkmicro/ark1668e_c281/Kconfig
```kconfig
if TARGET_ARK1668E_C281

config SYS_BOARD
	default "ark1668e_c281"

config SYS_VENDOR
	default "arkmicro"

config SYS_CONFIG_NAME
	default "ark1668e_c281"

endif
```
